## smart-pots-gateway/main/Kconfig.projbuild
```kconfig
menu "SmartPots configuration"

    config ESP_WIFI_SSID
        string "WiFi SSID"
        default ""

    config ESP_WIFI_PASSWORD
        string "WiFi Password"
        default ""

    config ESP_MAXIMUM_RETRY
        int "Maximum retry"
        default 5

endmenu
```
